## Kconfig
```kconfig
menu "General settings"
choice
  prompt "Machine selection"
  help
    OE MACHINE to use during the build.

config MACHINE_IMX6ULL_A1_GW
  bool "A1 i.MX6ULL A1 GW"
  help
    OE MACHINE variable is set to a1-imx6ull-gw .

endchoice

choice
  prompt "OE release selection"
  help
    OE release to use during the build .

config RELEASE_SCARTHGAP
  bool "OE Scarthgap 5.0 LTS"
  help
    OE Scarthgap 5.0 LTS release .
endchoice

choice
  prompt "OE distro selection"
  default USE_A1LINUX_DISTRO if INCLUDE_AUTOMATION_ONE_EXTRAS

config USE_NODISTRO
  bool "Use OE nodistro distribution"
  help
    Use the OE nodistro distribution

config USE_A1LINUX_DISTRO
  bool "Use the A1Linux distribution"
  depends on INCLUDE_AUTOMATION_ONE_EXTRAS
  help
    Use the A1Linux Distribution which is specifically tuned for the
    AutomationOne Gateways.
endchoice

config KAS_TARGET_IMAGE
  string "KAS Target image"
  default "a1-image" if INCLUDE_AUTOMATION_ONE_EXTRAS
  default "core-image-base" if !INCLUDE_AUTOMATION_ONE_EXTRAS
  help
    The build target that will be built. This is often an image name, e.g.
    core-image-base.

config INCLUDE_SDK_YML
  bool "Populate SDK for image recipe"
  help
    Populate SDK for selected image recipe.

config USE_LTO
  bool "Enable Link Time Optimization"
  default y
  help
    Enable Link Time Optimization for the image recipe.
endmenu

menu "Customization"

menu "Password Settings"
choice
  prompt "Root password settings"
  help
    Set how the root password should be set for the image recipe.
  default USE_NO_ROOT_PASSWORD

config USE_NO_ROOT_PASSWORD
  bool "Don't set any root password"
  help
    Don't set a root password for the image recipe. This might make
    it impossible to access the gateway.

config INCLUDE_DEBUG_TWEAKS
  bool "Set Debug Tweaks for the image recipe (DEBUG ONLY!)"
  help
    Set Debug Tweaks for the image recipe. This essentially removes any
    password protection.

config USE_ROOT_PASSWORD
  bool "Use clear text to set root password"
  help
    Set the root password in clear text for the image recipe.

config USE_ROOT_PASSWORD_HASH
  bool "Use hash to set root password"
  help
    Set the root password as a hash for the image recipe.
endchoice

config ROOT_PASSWORD
  string "Root password"
  depends on USE_ROOT_PASSWORD
  help
    The root password to set for the image recipe.

config ROOT_PASSWORD_HASH
  string "Root password hash"
  depends on USE_ROOT_PASSWORD_HASH
  help
    The hash of the root password to set for the image recipe.
    There is no need to escape any hashes.

config ROOT_AUTHORIZED_KEYS
  string "Root authorized keys"
  help
    The (absolute) path to the authorized_keys file to be used for
    the root user.

endmenu

menu "Network Configuration"
config USE_END0_DHCP
  bool "Enable DHCP Server on the lower Ethernet port"
  help
    Per default the lower Ethernet port is configured as a DHCP client.
    This option activates the dhcp-server network configuration for the
    lower Ethernet port instead.

config END0_DHCP
  string
  default "false" if !USE_END0_DHCP
  default "true" if USE_END0_DHCP

config USE_END1_DHCP
  bool "Enable DHCP Server on the upper Ethernet port"
  help
    Per default the upper Ethernet port is configured as a DHCP client.
    This option activates the dhcp-server network configuration for the
    upper Ethernet port instead.

config END1_DHCP
  string
  default "false" if !USE_END1_DHCP
  default "true" if USE_END1_DHCP
endmenu

menu "NTP Settings"

choice
  prompt "NTP Provider"
  default USE_SYSTEMD_TIMESYNCD
  help
    Select the NTP provider to use for the image recipe.

config NO_NTP
  bool "No NTP provider"
  help
    Don't use an NTP provider for the image recipe.

config USE_SYSTEMD_TIMESYNCD
  bool "Use systemd-timesyncd"
  help
    Use systemd-timesyncd as the NTP provider for the image recipe.

config USE_NTPD
  bool "Use NTPD"
  help
    Use NTPD as the NTP provider for the image recipe.

config USE_CHRONY
  bool "Use Chrony"
  help
    Use Chrony as the NTP provider for the image recipe.

endchoice

config NTP_PROVIDER
  string
  default "ntpd" if USE_NTPD
  default "timesyncd" if USE_SYSTEMD_TIMESYNCD
  default "chrony" if USE_CHRONY
  default "none" if NO_NTP

endmenu

endmenu

menu "Optional Packages and Features"

config INCLUDE_AUTOMATION_ONE_EXTRAS
  bool "Include the automation-one extras layer"
  default y
  help
    Include automation-one extras layer. This layer contains additional
    recipes and configurations for the AutomationOne Gateways beyond the
    standard OE layers.

config INCLUDE_IOTSUITE
  bool "Include the iotsuite layer"
  default n
  help
    Include iotsuite layer.

config INCLUDE_RAUC

  bool "Include RAUC update handler layer"
  default n
  help
    Include the rauc update handler layer. It is recommended to also
    use include Python, since the rauc hawkbit client requires it.

config RAUC_KEY_FILE
  string "RAUC key file"
  depends on INCLUDE_RAUC
  help
    The (absolute) path to the RAUC key file.

config RAUC_CERT_FILE
  string "RAUC certificate file"
  depends on INCLUDE_RAUC
  help
    The (absolute) path to the RAUC certificate file.

config RAUC_KEYRING_FILE
  string "RAUC keyring file"
  depends on INCLUDE_RAUC
  help
    The (absolute) path to the RAUC keyring file.

config INCLUDE_PYTHON
  bool "Include Python"
  default y if INCLUDE_RAUC
  default n if !INCLUDE_RAUC
  help
    Include Python in the image recipe

config INCLUDE_A1_SUITE_BOOL
  bool "Include the AutomationOne Suite"
  depends on INCLUDE_PYTHON && INCLUDE_AUTOMATION_ONE_EXTRAS
  default n
  help
    Include the AutomationOne Suite in the image recipe

config INCLUDE_A1_SUITE
  string
  default "true" if INCLUDE_A1_SUITE_BOOL
  default "false" if !INCLUDE_A1_SUITE_BOOL

config INCLUDE_MBUSD_BOOL
  bool "Include mbusd"
  default n
  help
    Include mbusd in the image recipe

config INCLUDE_MBUSD
  string
  default "true" if INCLUDE_MBUSD_BOOL
  default "false" if !INCLUDE_MBUSD_BOOL

config INCLUDE_NODE_RED
  bool "Include Node-RED (warning: very large)"
  default n
  help
    Include Node-RED in the image recipe. Since node-red depends on the
    node-js framework, it takes up a lot of space on the rootfs. The
    resulting image will properly be to large to include this in the
    nand image. This can be solved by increasing the size of the rootfs
    partition in the image_types_a1_ubi bbclass. Keep in mind however,
    that there is currently no automatic mechanism to increase partition
    size during an update. This means that the user has to manually
    increase the rootfs partition size before updating from a smaller to
    a larger image.

endmenu

menu "Inferred and expert settings"
config KAS_BUILD_SYSTEM
  string "KAS build system"
  default "openembedded"
  help
    The build_system that will used. The static kconfig string variable
    KAS_BUILD_SYSTEM defines this value which must be openembedded, oe
    or isar is set.

config KAS_INCLUDE_RELEASE_YML_FILE
  string "KAS OE release YML file"
  default "include/common-scarthgap.yml" if RELEASE_SCARTHGAP

config KAS_INCLUDE_BSP_YML_FILE
  string "KAS OE MACHINE and BSP layer YML file"
  depends on MACHINE_IMX6ULL_A1_GW
  default "a1-imx6ull-gw.yml" if MACHINE_IMX6ULL_A1_GW

config KAS_INCLUDE_SDK_YML_FILE
  string "KAS SDK YML file"
  depends on INCLUDE_SDK_YML
  default "include/common-sdk.yml"

config KAS_INCLUDE_DEBUG_TWEAKS_YML_FILE
  string "KAS DEBUG TWEAKS file"
  depends on INCLUDE_DEBUG_TWEAKS
  default "include/common-debug-tweaks.yml"

config KAS_INCLUDE_LTO_YML_FILE
  string "KAS LTO YML file"
  depends on USE_LTO
  default "include/common-lto.yml"

config KAS_INCLUDE_A1EXTRAS_YML_FILE
  string "KAS AutomationOne extras YML file"
  depends on INCLUDE_AUTOMATION_ONE_EXTRAS
  default "include/common-a1-extras.yml"

config KAS_INCLUDE_A1LINUX_DISTRIBUTION_YAML_FILE
  string "KAS A1Linux distribution YML file"
  depends on USE_A1LINUX_DISTRO
  default "include/common-a1linux.yml"

config KAS_INCLUDE_RAUC_YML_FILE
  string "KAS RAUC YML file"
  depends on INCLUDE_RAUC
  default "include/common-rauc.yml"

config KAS_INCLUDE_IOTSUITE_YML_FILE
  string "KAS IoT Suite YML file"
  depends on INCLUDE_IOTSUITE
  default "include/common-iotsuite.yml"

  config KAS_INCLUDE_PYTHON_YML_FILE
  string "KAS Python YML file"
  depends on INCLUDE_PYTHON
  default "include/common-python.yml"

config KAS_INCLUDE_NODE_RED_YML_FILE
  string "KAS Node-RED YML file"
  depends on INCLUDE_NODE_RED
  default "include/common-node-red.yml"

endmenu
```
